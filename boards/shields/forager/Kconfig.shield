## boards/shields/forager/Kconfig.shield
```kconfig
config SHIELD_FORAGER
    bool

config SHIELD_FORAGER_LEFT
    def_bool $(shields_list_contains,forager_left)
    select ZMK_SPLIT
    select SHIELD_FORAGER

config SHIELD_FORAGER_RIGHT
    def_bool $(shields_list_contains,forager_right)
    select ZMK_SPLIT
    select SHIELD_FORAGER

config SHIELD_FORAGER_DONGLE
    def_bool $(shields_list_contains,forager_dongle)
    select ZMK_SPLIT_ROLE_CENTRAL
    select ZMK_SPLIT
    select SHIELD_FORAGER
```

## config/west.yml
```yaml
manifest:
  remotes:
    - name: Horus-Heretic                            # <--- add this
      url-base: https://github.com/Horus-Heretic     # <--- and this
    - name: zmkfirmware
      url-base: https://github.com/zmkfirmware
    - name: carrefinho                            # <--- add this
      url-base: https://github.com/carrefinho     # <--- and this
    - name: caksoylar                             # <---
      url-base: https://github.com/caksoylar      # <---
    # Additional modules containing boards/shields/custom code can be listed here as well
    # See https://docs.zephyrproject.org/3.2.0/develop/west/manifest.html#projects
  projects:
    - name: zmk
      remote: zmkfirmware
      revision: main
      import: app/west.yml
    - name: forager-zmk-module                    # <---
      remote: Horus-Heretic                          # <---
      revision: main                              # <---
    - name: zmk-rgbled-widget                     # <---
      remote: caksoylar                           # <---
      revision: main                              # <---
    - name: prospector-zmk-module                 # <--- and these
      remote: carrefinho                          # <---
      revision: main                              # <---
  self:
    path: config
```
